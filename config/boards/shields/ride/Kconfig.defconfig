## config/boards/shields/ride/Kconfig.defconfig
```kconfig
if SHIELD_RIDE_LEFT

config ZMK_KEYBOARD_NAME
	default "Ride"

config ZMK_SPLIT_ROLE_CENTRAL
	default y

endif

if SHIELD_RIDE_LEFT || SHIELD_RIDE_RIGHT

config ZMK_SPLIT
	default y
 
if ZMK_DISPLAY

config I2C
	default y

config SSD1306
	default y

endif # ZMK_DISPLAY

endif
```
